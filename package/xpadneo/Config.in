## package/xpadneo/Config.in
```kconfig
config BR2_PACKAGE_XPADNEO
	bool "xpadneo"

	  help
	    Linux kernel driver for Xbox One and Xbox Series X|S accessories using Bluetooth
	    
	    https://atar-axis.github.io/xpadneo/
```
